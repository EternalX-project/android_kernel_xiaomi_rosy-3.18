## arch/arm64/hotplug/Kconfig
```kconfig
config MSM_HOTPLUG
	bool "Enable MSM-Hotplug CPUs Hotplug drivers"
	depends on HOTPLUG_CPU
	default n
	help
	  The MSM hotplug driver controls on-/offlining of additional cores based on current cpu load.
	  
config ALUCARD_HOTPLUG
	bool "Enable Alucard CPUs Hotplug drivers"
	depends on HOTPLUG_CPU
 	default n
 	help
 	  Generic Alucard-hotplug cpu hotplug driver for ARM SOCs

config ASMP_HOTPLUG
    bool "Enable AutoSMP CPUs Hotplug drivers"
    depends on SMP && HOTPLUG_CPU
    default n
    help
      Automatically hotplugs the multiple cpu cores on and off
      based on cpu load and suspend state
```

## drivers/input/fingerprint/fpc/Kconfig
```kconfig
config FINGERPRINT_FPC1020
	tristate "FPC1020 fingerprint driver"
	help
	  Say Y here to compile fingerprint drivers for FingerPrint Cards
	  FPC1020.

	  If unsure, say Y.
```

## drivers/input/fingerprint/goodix/Kconfig
```kconfig
config FINGERPRINT_GF3208
	tristate "GF3208 fingerprint driver"
	help
	  Say Y here to compile fingerprint drivers for Goodix GF3208.

	  If unsure, say Y.
```
